## CMakeLists.txt
```
# SPDX-License-Identifier: Apache-2.0

cmake_minimum_required(VERSION 3.20.0)
find_package(Zephyr REQUIRED HINTS $ENV{ZEPHYR_BASE})
project(performance_test)

target_sources(app PRIVATE src/main.c)
```

## Kconfig
```
mainmenu "PerfT"

source "Kconfig.zephyr"

config PERFORMANCE_TESTING
  default y
  bool
  select USE_STM32_HAL_GPIO
  select USE_STM32_LL_GPIO
```

## west.yml
```
manifest:
  remotes:
    - name: zephyrproject-rtos
      url-base: https://github.com/zephyrproject-rtos
  projects:
    - name: zephyr
      remote: zephyrproject-rtos
      revision: v3.4.0
      import: true
  self:
    path: app-performance_test
```

## prj.conf
```kconfig
# Drivers and peripherals
CONFIG_I2C=n
CONFIG_WATCHDOG=n
CONFIG_GPIO=y
CONFIG_PINCTRL=n
CONFIG_SPI=n
CONFIG_SERIAL=n
CONFIG_FLASH=n

# Power management
CONFIG_PM=n

# Interrupts
CONFIG_DYNAMIC_INTERRUPTS=n
CONFIG_IRQ_OFFLOAD=n

# Memory protection
CONFIG_THREAD_STACK_INFO=n
CONFIG_THREAD_CUSTOM_DATA=n
CONFIG_FPU=n

# Boot
CONFIG_BOOT_BANNER=n
CONFIG_BOOT_DELAY=0

# Console
CONFIG_CONSOLE=n
CONFIG_UART_CONSOLE=n
CONFIG_STDOUT_CONSOLE=n
CONFIG_PRINTK=n
CONFIG_EARLY_CONSOLE=n

CONFIG_ARM_MPU=n

# CONFIG_SYS_CLOCK_TICKS_PER_SEC=1
# CONFIG_TICKLESS_KERNEL=n

# Reduce memory/code footprint
CONFIG_BT=n
CONFIG_FORCE_NO_ASSERT=y

# Build
CONFIG_ASSERT_VERBOSE=n

CONFIG_SIZE_OPTIMIZATIONS=n
CONFIG_SPEED_OPTIMIZATIONS=y
CONFIG_DEBUG_OPTIMIZATIONS=n
CONFIG_NO_OPTIMIZATIONS=n

# Threading
CONFIG_MULTITHREADING=y
# CONFIG_KERNEL_MEM_POOL=n
# CONFIG_NUM_PREEMPT_PRIORITIES=0

# Timers
# CONFIG_SYS_CLOCK_EXISTS=n
```

## boards/nucleo_g071rb.overlay
```dts
#include <zephyr/dt-bindings/gpio/gpio.h>

/ { 
  zephyr,user
  {
    signal-gpios = <&gpioa 8 GPIO_ACTIVE_HIGH>;
  };
};
```

## src/main.c
```c
/*
 * SPDX-License-Identifier: Apache-2.0
 */

/**
 * @file Performance Testing App
 */

#include <zephyr/kernel.h>
#include <zephyr/device.h>
#include <zephyr/drivers/gpio.h>

// For STM HAL/LL
#include <soc.h>
#include <stm32_ll_gpio.h>
// #include <stm32g0xx_hal.h>

// For STM HAL/LL
#define SIGNAL_GPIO_Port  GPIOA
#define SIGNAL_Pin        GPIO_PIN_8

// For Zephyr API
#define ZEPHYR_USER_NODE DT_PATH(zephyr_user)
const struct gpio_dt_spec signal = GPIO_DT_SPEC_GET(ZEPHYR_USER_NODE, signal_gpios);

int main(void)
{
  // const struct device *dev = &signal.port;
  // const struct gpio_stm32_config *cfg = dev->config;
  // GPIO_TypeDef *gpio = (GPIO_TypeDef *)cfg->base;

  /* Configure the pin */
  gpio_pin_configure_dt(&signal, GPIO_OUTPUT_INACTIVE);
  uint8_t state = 0;
  while (1)
  {
    state ^= 1;
    // ZEPHYR API
    // gpio_pin_set_dt(&signal, state);
    gpio_pin_toggle_dt(&signal);

    // LL
    // LL_GPIO_TogglePin(SIGNAL_GPIO_Port,SIGNAL_Pin);
    // LL_GPIO_WriteOutputPort(SIGNAL_GPIO_Port, state<<8);

    // HAL
    // HAL_GPIO_TogglePin(SIGNAL_GPIO_Port,SIGNAL_Pin);
    // HAL_GPIO_WritePin(SIGNAL_GPIO_Port, SIGNAL_Pin, state);

    // WRITE_REG(gpio->BSRR, pins); # not finished.
  
    // k_sleep(K_USEC(100000));
  }
  return 0;
}
```
